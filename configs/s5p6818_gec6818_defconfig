## configs/s5p6818_gec6818_defconfig
```kconfig
CONFIG_ARM=y
CONFIG_BOARD_EARLY_INIT_F=y
CONFIG_ARCH_NEXELL=y
CONFIG_ARCH_S5P6818=y
CONFIG_TARGET_GEC6818=y
CONFIG_SYS_BOARD="gec6818"
CONFIG_SYS_VENDOR="s5p6818"
CONFIG_SYS_CONFIG_NAME="s5p6818_gec6818"
CONFIG_HAS_CUSTOM_SYS_INIT_SP_ADDR=y
CONFIG_CUSTOM_SYS_INIT_SP_ADDR=0x43C00000
CONFIG_ENV_SIZE=0x4000
CONFIG_ENV_OFFSET=0x2E0200
CONFIG_DM_I2C=y
CONFIG_DM_GPIO=y
CONFIG_DEFAULT_DEVICE_TREE="s5p6818-gec6818"
CONFIG_FIT=y
CONFIG_SUPPORT_RAW_INITRD=y
# CONFIG_CMD_IMI is not set
# CONFIG_CMD_IMLS is not set
# CONFIG_CMD_FLASH is not set
CONFIG_BOOTDELAY=1
CONFIG_OF_BOARD_SETUP=y
CONFIG_SYS_PBSIZE=1050
CONFIG_BOARD_LATE_INIT=y
CONFIG_HUSH_PARSER=y
CONFIG_SYS_PROMPT="nanopi3# "
CONFIG_CMD_I2C=y
CONFIG_CMD_USB=y
# CONFIG_CMD_FPGA is not set
CONFIG_CMD_GPIO=y
CONFIG_CMD_MMC=y
CONFIG_CMD_BMP=y
# CONFIG_CMD_SETEXPR is not set
CONFIG_SYS_MMC_ENV_DEV=1
# CONFIG_CMD_NET is not set
# CONFIG_CMD_NFS is not set
CONFIG_CMD_FDISK=y
CONFIG_FS_FAT=y
CONFIG_CMD_FAT=y
CONFIG_CMD_EXT4=y
CONFIG_CMD_EXT4_WRITE=y
CONFIG_FS_EXT4=y
CONFIG_EXT4_WRITE=y
CONFIG_CMD_EXT4_IMG_WRITE=y
CONFIG_ENV_OVERWRITE=y
CONFIG_ENV_IS_IN_MMC=y
CONFIG_CMD_SD_RECOVERY=y
CONFIG_CMD_PMIC=y
CONFIG_CMD_REGULATOR=y
CONFIG_OF_CONTROL=y
# CONFIG_OF_EMBED=y
CONFIG_DM=y
CONFIG_NX_GPIO=y
CONFIG_DM_I2C_GPIO=y
CONFIG_SYS_I2C_NEXELL=y
CONFIG_MMC_DW=y
CONFIG_DM_PMIC=y
CONFIG_DM_PMIC_AXP228=y
CONFIG_DM_REGULATOR=y
CONFIG_DM_REGULATOR_AXP228=y
CONFIG_DM_PWM=y
CONFIG_PWM_NX=y
CONFIG_USB=y
CONFIG_DM_USB=y
CONFIG_USB_EHCI_HCD=y
CONFIG_USB_STORAGE=y
CONFIG_DISPLAY_PORT=y
CONFIG_VIDEO=y
CONFIG_VIDEO_LOGO=y
CONFIG_DISPLAY=y
CONFIG_VIDEO_NX=y
CONFIG_VIDEO_NX_RGB=y
CONFIG_VIDEO_NX_LVDS=y
CONFIG_VIDEO_NX_HDMI=y
CONFIG_SPLASH_SCREEN=y
CONFIG_SPLASH_SCREEN_ALIGN=y
CONFIG_SPLASH_SOURCE=y
CONFIG_BMP_24BPP=y
CONFIG_REGEX=y
CONFIG_ERRNO_STR=y
CONFIG_ROOT_DEV=1
CONFIG_BOOT_PART=1
CONFIG_ROOT_PART=2
CONFIG_TEXT_BASE=0x43C00000
CONFIG_SYS_LOAD_ADDR=0x48000000
CONFIG_ENABLE_ARM_SOC_BOOT0_HOOK=n
CONFIG_ARCH_CPU_INIT=y
CONFIG_USB_GADGET=y
CONFIG_USB_GADGET_DUALSPEED=y
CONFIG_USB_GADGET_DOWNLOAD=y
CONFIG_USB_GADGET_VENDOR_NUM=0x18d1
CONFIG_USB_GADGET_PRODUCT_NUM=0x0002
CONFIG_CONSOLE_SCROLL_LINES=10
CONFIG_USB_GADGET_MANUFACTURER="Nexell Corporation"
CONFIG_CMD_MEMTEST=y
CONFIG_ARCH_MISC_INIT=y
CONFIG_DEBUG_UART_BASE=0xC00A1000
CONFIG_DEBUG_UART_CLOCK=150000000
CONFIG_SYS_ICACHE_OFF=y
CONFIG_SYS_DCACHE_OFF=y
CONFIG_SYS_MEMTEST_START=0x40000000
CONFIG_SYS_MEMTEST_END=0x7DB00000
CONFIG_NR_DRAM_BANKS=2
# CONFIG_DM_SERIAL=y
CONFIG_S5P6818_SERIAL=y
CONFIG_BAUDRATE=115200
CONFIG_TIMER_SYS_TICK_CH=0
CONFIG_PINCTRL_NEXELL=y
CONFIG_NEXELL_DWMMC=y
```
